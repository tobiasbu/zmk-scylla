#include "scylla.dtsi"

&default_transform {
	col-offset = <6>;
};

&kscan0 {
    col-gpios
        = <&gpio1 4 (GPIO_ACTIVE_HIGH | GPIO_PULL_DOWN)>   // col5 in the schematic
        , <&gpio0 11 (GPIO_ACTIVE_HIGH | GPIO_PULL_DOWN)>  // col4 in the schematic
        , <&gpio1 0  (GPIO_ACTIVE_HIGH | GPIO_PULL_DOWN)>  // col3 in the schematic
        , <&gpio0 9 (GPIO_ACTIVE_HIGH | GPIO_PULL_DOWN)>   // col2 in the schematic
        , <&gpio0 29  (GPIO_ACTIVE_HIGH | GPIO_PULL_DOWN)> // col1 in the schematic
        , <&gpio0 2  (GPIO_ACTIVE_HIGH | GPIO_PULL_DOWN)>  // col0 in the schematic
        ;
};
