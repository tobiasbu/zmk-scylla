## boards/shields/scylla/Kconfig.shield
```kconfig
# No whitespace after the comma or in your part name!
config SHIELD_SCYLLA_LEFT
    def_bool $(shields_list_contains,scylla_left)

# No whitespace after the comma or in your part name!
config SHIELD_SCYLLA_RIGHT
    def_bool $(shields_list_contains,scylla_right)
	
config SHIELD_SCYLLA_DONGLE
    def_bool $(shields_list_contains,scylla_dongle)
```
